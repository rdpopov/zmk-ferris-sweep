## config/boards/shileds/dongle/Kconfig.shield
```kconfig
# Copyright (c) 2020 The ZMK Contributors
# SPDX-License-Identifier: MIT

config SHIELD_DONGLE_DONGLE
    def_bool $(shields_list_contains,dongle_dongle)
```

## config/west.yml
```yaml
manifest:
  remotes:
    - name: zmkfirmware
      url-base: https://github.com/zmkfirmware
    - name: xqinx
      url-base: https://github.com/xqinx
    - name: urob
      url-base: https://github.com/urob
  projects:
    - name: zmk
      remote: urob
      revision: main-3.2
      import: app/west.yml
    - name: joystick
      remote: xqinx
      revision: thb
  self:
    path: config
```
